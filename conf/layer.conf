## conf/layer.conf
```bitbake
# Layer configuration for meta-mbus
# Copyright 2020 Ivo Peperko

BBPATH .= ":${LAYERDIR}"

# We have recipes-* directories, add to BBFILES
BBFILES += "${LAYERDIR}/recipes-*/*/*.bb \
            ${LAYERDIR}/recipes-*/*/*.bbappend"

BBFILE_COLLECTIONS += "meta-mbus"
BBFILE_PATTERN_meta-mbus = "^${LAYERDIR}/"
BBFILE_PRIORITY_meta-mbus = "6"

LAYERDEPENDS_meta-mbus = "core"
LAYERSERIES_COMPAT_meta-mbus = "warrior zeus dunfell"
```
